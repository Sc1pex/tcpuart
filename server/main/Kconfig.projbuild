## server/main/Kconfig.projbuild
```kconfig
menu "TcpUart Server Configuration"
    config ESP_TCP_SERVER_PORT
        int "Port number to listen on"
        default 15113
        help
            Port number to listen on

    rsource "config/Kconfig.wifi"
    rsource "config/Kconfig.reset"
    rsource "config/Kconfig.uart"
endmenu
```

## server/main/config/Kconfig.reset
```kconfig
menu "Remote Reset Configuration"
    config ESP_UART_RESET_ENABLED
        bool "Enable Remote Reset Support"
        default n
        help
            If enabled, the ESP32 can trigger a hardware reset on the connected device.

    if ESP_UART_RESET_ENABLED
        config ESP_UART_RESET_PIN
            int "Reset GPIO Pin"
            default 18
            help
                GPIO number connected to the target device's Reset pin.

        config ESP_UART_RESET_ACTIVE_LOW
            bool "Active Low Reset"
            default y
            help
                Check if the target resets when the pin is pulled to GND. 
                Uncheck for Active High (pull to 3.3V).

        config ESP_UART_RESET_DURATION_MS
            int "Reset Pulse Duration (ms)"
            default 100
            range 1 5000
            help
                How long (in milliseconds) to hold the reset signal before releasing it.
    endif
endmenu
```

## server/main/config/Kconfig.status_led
```kconfig
menu "Status LED"
    config ESP_STATUS_LED_ENABLED
        bool "Enable RGB LED status indicator"
        default n
        help 
            If enabled, a WS2812B (NeoPixel) LED will be used to visually indicate the current status of the ESP32 (e.g., Wi-Fi connecting, connected, errors).

    if ESP_STATUS_LED_ENABLED
        config ESP_STATUS_LED_GPIO
            int "The GPIO pin of the LED"
            default 48
            help
                The GPIO pin connected to the addressable RGB LED.
                Default is 48, which is the built-in NeoPixel on the ESP32-S3-DevKitC-1.

        config ESP_STATUS_LED_BRIGHTNESS
            int "LED Brightness (1-100)"
            range 1 100
            default 20
            help
                Sets the maximum brightness of the status LED as a percentage.
                Addressable LEDs are extremely bright at 100%. A value between 10 and 20 is highly recommended for indoor use.

        config ESP_STATUS_LED_UART_ACTIVITY
            bool "Flash LED on UART Data Activity"
            default y
            help
                If enabled, the LED will flash rapidly when data is sent or received over UART.
                Disable this if you find the constant flashing during high data transfer distracting.
    endif
endmenu
```

## server/main/config/Kconfig.tailscale
```kconfig
menu "Tailscale Configuration"
    config ESP_TAILSCALE_ENABLED
        bool "Enable Tailscale VPN (MicroLink)"
        default n
        help
            Connects the ESP32 directly to a Tailscale network using MicroLink.

    if ESP_TAILSCALE_ENABLED
        config ESP_TAILSCALE_AUTH_KEY
            string "Tailscale Auth Key"
            default ""
            help
                Reusable authentication key from your Tailscale (or Headscale) admin panel.

        config ESP_TAILSCALE_DEVICE_NAME
            string "Device Name"
            default "tcpuart-esp32"
            help
                Hostname for this device on your Tailnet.
    endif
endmenu
```

## server/main/config/Kconfig.uart
```kconfig
menu "UART Configuration"
    config ESP_UART_PORT_NUM
        int "UART Port Number (0, 1, or 2)"
        range 0 2
        default 2
        help
            Which UART hardware peripheral to use. UART0 is usually reserved for console logs.

    config ESP_UART_TX_PIN
        int "UART TX Pin"
        default 17
        help
            GPIO number for the UART TX signal.

    config ESP_UART_RX_PIN
        int "UART RX Pin"
        default 16
        help
            GPIO number for the UART RX signal.

    config ESP_UART_HW_FLOW_CTRL
        bool "Enable Hardware Flow Control (RTS/CTS)"
        default n
        help
            If enabled, uses RTS and CTS pins to prevent buffer overflows during
            high-speed data transfer. The RTS line is asserted automatically by the
            hardware when the RX FIFO is nearly full, giving the sender time to stop
            before the buffer overflows.

    if ESP_UART_HW_FLOW_CTRL
        config ESP_UART_RTS_PIN
            int "UART RTS Pin"
            default 15
            help
                GPIO number for the UART RTS (Request To Send) signal.

        config ESP_UART_CTS_PIN
            int "UART CTS Pin"
            default 14
            help
                GPIO number for the UART CTS (Clear To Send) signal.
    endif
endmenu
```

## server/main/config/Kconfig.wifi
```kconfig
menu "Wifi Configuration"
    config ESP_WIFI_NETWORK_COUNT
        int "Number of WiFi networks to try"
        range 1 5
        default 1
        help
            WiFi SSID

    config ESP_WIFI_SSID_1
        string "WiFi 1 SSID"
        default "myssid"
        help
            WiFi SSID

    config ESP_WIFI_PASSWORD_1
        string "WiFi 1 Password"
        default "mypassword"
        help
            WiFi password

    if ESP_WIFI_NETWORK_COUNT >= 2
        config ESP_WIFI_SSID_2
            string "WiFi 2 SSID"
            default "myssid"
            help
                WiFi SSID

        config ESP_WIFI_PASSWORD_2
            string "WiFi 2 Password"
            default "mypassword"
            help
                WiFi password
    endif

    if ESP_WIFI_NETWORK_COUNT >= 3
        config ESP_WIFI_SSID_3
            string "WiFi 3 SSID"
            default "myssid"
            help
                WiFi SSID

        config ESP_WIFI_PASSWORD_3
            string "WiFi 3 Password"
            default "mypassword"
            help
                WiFi password
    endif

    if ESP_WIFI_NETWORK_COUNT >= 4
        config ESP_WIFI_SSID_4
            string "WiFi 4 SSID"
            default "myssid"
            help
                WiFi SSID

        config ESP_WIFI_PASSWORD_4
            string "WiFi 4 Password"
            default "mypassword"
            help
                WiFi password
    endif

    if ESP_WIFI_NETWORK_COUNT >= 5
        config ESP_WIFI_SSID_5
            string "WiFi 5 SSID"
            default "myssid"
            help
                WiFi SSID

        config ESP_WIFI_PASSWORD_5
            string "WiFi 5 Password"
            default "mypassword"
            help
                WiFi password
    endif

    config ESP_WIFI_MAX_RETRIES
        int "WiFi max retries"
        default 5
        help
            How many times to retry before giving up
endmenu
```
